VERSION ""

NS_ :

BS_:

BU_: RADAR XXX

BO_ 98 TRACK_0: 16 RADAR
 SG_ CHECKSUM : 7|16@0+ (1,0) [0|65535] "" XXX
 SG_ COUNTER : 23|8@0+ (1,0) [0|65535] "" XXX
 SG_ COUNTER_2 : 27|4@0+ (1,0) [0|15] "" XXX

BO_ 100 TRACK_1: 16 RADAR
 SG_ CHECKSUM : 7|16@0+ (1,0) [0|65535] "" XXX
 SG_ COUNTER : 23|8@0+ (1,0) [0|65535] "" XXX
 SG_ COUNTER_2 : 27|4@0+ (1,0) [0|15] "" XXX

BO_ 102 TRACK_2: 16 RADAR
 SG_ CHECKSUM : 7|16@0+ (1,0) [0|65535] "" XXX
 SG_ COUNTER : 23|8@0+ (1,0) [0|65535] "" XXX
 SG_ COUNTER_2 : 27|4@0+ (1,0) [0|15] "" XXX

BO_ 104 TRACK_3: 16 RADAR
 SG_ CHECKSUM : 7|16@0+ (1,0) [0|65535] "" XXX
 SG_ COUNTER : 23|8@0+ (1,0) [0|65535] "" XXX
 SG_ COUNTER_2 : 27|4@0+ (1,0) [0|15] "" XXX

BO_ 106 TRACK_4: 16 RADAR
 SG_ CHECKSUM : 7|16@0+ (1,0) [0|65535] "" XXX
 SG_ COUNTER : 23|8@0+ (1,0) [0|65535] "" XXX
 SG_ COUNTER_2 : 27|4@0+ (1,0) [0|15] "" XXX

BO_ 108 TRACK_5: 16 RADAR
 SG_ CHECKSUM : 7|16@0+ (1,0) [0|65535] "" XXX
 SG_ COUNTER : 23|8@0+ (1,0) [0|65535] "" XXX
 SG_ COUNTER_2 : 27|4@0+ (1,0) [0|15] "" XXX

BO_ 110 TRACK_6: 16 RADAR
 SG_ CHECKSUM : 7|16@0+ (1,0) [0|65535] "" XXX
 SG_ COUNTER : 23|8@0+ (1,0) [0|65535] "" XXX
 SG_ COUNTER_2 : 27|4@0+ (1,0) [0|15] "" XXX

BO_ 112 TRACK_7: 16 RADAR
 SG_ CHECKSUM : 7|16@0+ (1,0) [0|65535] "" XXX
 SG_ COUNTER : 23|8@0+ (1,0) [0|65535] "" XXX
 SG_ COUNTER_2 : 27|4@0+ (1,0) [0|15] "" XXX

BO_ 114 TRACK_8: 16 RADAR
 SG_ CHECKSUM : 7|16@0+ (1,0) [0|65535] "" XXX
 SG_ COUNTER : 23|8@0+ (1,0) [0|65535] "" XXX
 SG_ COUNTER_2 : 27|4@0+ (1,0) [0|15] "" XXX

BO_ 116 TRACK_9: 16 RADAR
 SG_ CHECKSUM : 7|16@0+ (1,0) [0|65535] "" XXX
 SG_ COUNTER : 23|8@0+ (1,0) [0|65535] "" XXX
 SG_ COUNTER_2 : 27|4@0+ (1,0) [0|15] "" XXX

BO_ 118 TRACK_10: 16 RADAR
 SG_ CHECKSUM : 7|16@0+ (1,0) [0|65535] "" XXX
 SG_ COUNTER : 23|8@0+ (1,0) [0|65535] "" XXX
 SG_ COUNTER_2 : 27|4@0+ (1,0) [0|15] "" XXX

BO_ 120 TRACK_11: 16 RADAR
 SG_ CHECKSUM : 7|16@0+ (1,0) [0|65535] "" XXX
 SG_ COUNTER : 23|8@0+ (1,0) [0|65535] "" XXX
 SG_ COUNTER_2 : 27|4@0+ (1,0) [0|15] "" XXX

BO_ 122 TRACK_12: 16 RADAR
 SG_ CHECKSUM : 7|16@0+ (1,0) [0|65535] "" XXX
 SG_ COUNTER : 23|8@0+ (1,0) [0|65535] "" XXX
 SG_ COUNTER_2 : 27|4@0+ (1,0) [0|15] "" XXX

BO_ 124 TRACK_13: 16 RADAR
 SG_ CHECKSUM : 7|16@0+ (1,0) [0|65535] "" XXX
 SG_ COUNTER : 23|8@0+ (1,0) [0|65535] "" XXX
 SG_ COUNTER_2 : 27|4@0+ (1,0) [0|15] "" XXX

BO_ 126 TRACK_14: 16 RADAR
 SG_ CHECKSUM : 7|16@0+ (1,0) [0|65535] "" XXX
 SG_ COUNTER : 23|8@0+ (1,0) [0|65535] "" XXX
 SG_ COUNTER_2 : 27|4@0+ (1,0) [0|15] "" XXX

BO_ 128 TRACK_15: 16 RADAR
 SG_ CHECKSUM : 7|16@0+ (1,0) [0|65535] "" XXX
 SG_ COUNTER : 23|8@0+ (1,0) [0|65535] "" XXX
 SG_ COUNTER_2 : 27|4@0+ (1,0) [0|15] "" XXX
